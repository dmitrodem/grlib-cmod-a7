## grlib/designs/leon3-cmod-a7/config.in
```kconfig
#
# LEON3 configuration written in linux configuration language
#
# Written by Jiri Gaisler, Gaisler Research
#
# Comments and bug reports to support@gaisler.com
#
#

#define_bool CONFIG_MCTRL_RMW y
define_bool CONFIG_LEON3FT_PRESENT y
define_bool CONFIG_HAS_SHARED_GRFPU y

mainmenu_name "LEONMP Design Configuration"

mainmenu_option next_comment
  comment 'Synthesis      '
  source lib/techmap/gencomp/tech.in
endmenu

mainmenu_option next_comment
  comment 'Clock generation'
  source lib/techmap/clocks/clkgen.in
endmenu

source lib/gaisler/subsys/leon_dsu_stat_base.in
source lib/grlib/amba/amba.in

mainmenu_option next_comment
  comment 'Debug Link           '
  source lib/gaisler/jtag/jtag.in
endmenu

mainmenu_option next_comment
comment 'Peripherals             '

  mainmenu_option next_comment
  comment 'Memory controller             '
    source lib/esa/memoryctrl/mctrl.in
    source lib/gaisler/spi/spimctrl.in
    source lib/gaisler/misc/ahbstat.in
  endmenu

  mainmenu_option next_comment
  comment 'UARTs, timers and irq control         '
    source lib/gaisler/uart/uart1.in
    source lib/gaisler/irqmp/irqmp.in
    source lib/gaisler/misc/gptimer.in
    source lib/gaisler/misc/grgpio.in
  endmenu

endmenu

mainmenu_option next_comment
comment 'VHDL Debugging        '
  source lib/grlib/util/debug.in
endmenu
```
